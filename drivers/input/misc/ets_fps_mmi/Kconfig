## drivers/input/misc/ets_fps_mmi/Kconfig
```kconfig
#
# Egistec fingerprint driver
#

config INPUT_EGISTEC_FPS_MMI
	tristate "Egistec Fingerprint Sensor driver MMI Revision"
	default n
	help
	  Say Y here to enable the Egistec Fingerprint sensor driver.

	  To compile this driver as a module, choose M here. The
	  module will be called ets_fps_mmi.
```

## drivers/input/touchscreen/himax_mmi/Kconfig
```kconfig
#
# Himax Touchscreen MMI driver configuration
#

config TOUCHSCREEN_HIMAX_I2C
	tristate "HIMAX chipset i2c touchscreen"
	depends on TOUCHSCREEN_HIMAX_CHIPSET
	help
	  Say Y here to enable support for HIMAX CHIPSET over I2C based touchscreens.
	  If unsure, say N.

	  To compile this driver as a module, choose M here. The
	  module will be called himax_mmi.

config TOUCHSCREEN_HIMAX_INSPECT
	tristate "HIMAX inspect function"
	depends on TOUCHSCREEN_HIMAX_I2C
	help
	  Say Y here to enable HIMAX self test function.

	  If unsure, say N.

config TOUCHSCREEN_HIMAX_DEBUG
	tristate "HIMAX debug function"
	depends on TOUCHSCREEN_HIMAX_I2C
	help
	  Say Y here to enable support for HIMAX debug function.

	  If unsure, say N.

config HMX_DB
	tristate "HIMAX driver test over Dragon Board"
	depends on TOUCHSCREEN_HIMAX_I2C
	help
	  Say Y here to enable support for HIMAX driver test over Dragon Board.

	  If unsure, say N.
```

## drivers/input/touchscreen/novatek_mmi/Kconfig
```kconfig
#
# Novatek NT36xxx touchscreen driver configuration
#

config TOUCHSCREEN_NOVATEK_CHIPSET
	tristate "Novatek Touchscreen Driver MMI Revision"
	default n
	help
	  Say Y here if you have a Novatek NT36xxx touchscreen panel 
	  connected to your system.

	  To compile this driver as a module, choose M here. This module 
	  will be called nova_mmi.
```

## drivers/misc/awinic/aw869x/Kconfig
```kconfig
config INPUT_AWINIC_HAPTIC
	tristate "AW869X Haptic Driver"
	default n
	help
	  Say Y here to enable awinic aw869x haptic driver.

	  To compile this driver as a module, choose M here. The module
	  will be called aw869x.
```

## drivers/misc/mmi_sys_temp/Kconfig
```kconfig
config MMI_SYSTEM_TEMP
	tristate "System Temperatures driver MMI Revision"
	default n
	help
	  Say Y here to enable the System Temps driver.

	  To compile this driver as a module, choose M here. The module
	  will be called mmi_sys_temp.
```

## drivers/misc/motomods/Kconfig
```kconfig
#
# Moto Mod drivers
#
menu "Moto Mod drivers"
config MOTOMODS
	tristate "Motorola Z Moto Mods"
	depends on POWER_SUPPLY
	depends on PWM
	depends on SYSFS
	depends on SPI
	depends on USB
	depends on SND_SOC
	depends on MMC
	depends on LEDS_CLASS
	default n
	help
	  This option enables support for Moto Mod peripherals for the
	  Motorola Z family of handsets.

config MODS_2ND_GEN
	tristate
	depends on MOTOMODS
	default n

config MODS_USE_EXTCODEC_MI2S
	tristate
	depends on MOTOMODS
	default n
endmenu
```

## drivers/power/bq2597x_mmi/Kconfig
```kconfig
config BQ2597X_MMI_CHARGER
	tristate "TI BQ2597x Charger Driver"
	help
	  Say Y here to enable bq2597x charger driver

	  To compile this driver as a module, choose M here. The module
	  will be called bq2597x_mmi.
```

## drivers/power/mmi_pl_chg_manager/Kconfig
```kconfig
config MMI_PARALLEL_CHARGING
	tristate "Parallel Charging driver MMI Revision"
	default n
	help
	  Say Y here to enable the Parallel Charging driver.

	  To compile this driver as a module, choose M here. The module
	  will be called mmi_pl_chg_manager.
```
